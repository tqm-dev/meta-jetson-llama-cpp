## conf/layer.conf
```bitbake
BBPATH .= ":${LAYERDIR}"

# We have recipes directories, add to BBFILES
BBFILES += "\
	${LAYERDIR}/recipes-*/*/*.bb \
	${LAYERDIR}/recipes-*/*/*.bbappend \
"

BBFILE_COLLECTIONS += "jetson-llama-cpp"
BBFILE_PATTERN_jetson-llama-cpp = "^${LAYERDIR}/"
BBFILE_PRIORITY_jetson-llama-cpp = "5"
LAYERDEPENDS_jetson-llama-cpp = "core"
LAYERSERIES_COMPAT_jetson-llama-cpp = "kirkstone"
```
